/*

display mode cycle: clock  hh:mm, timer Tmmm, temperature nn:nc, relative_humidity nn:n%
timer display cycle will be skipped if timer=0
setting mode: timer Tmmm, alarm_hour hh, alarm_minute mm, year Y_yy, month M_mm, day D_dd, hour hh:, minute :mm, quarter_chime c, brightness
maximum timer 999 minutes

hour side switch for increment
minute side switch for change setting mode
press both switch for setting to zero on current set item
set alarm_hour >= 24 to turn off alarm clock, 
press any switch to stop alarm during display mode
press increment switch to scroll Ahhmm Cyyyy-mmm-dd ddd during display mode
chime only work from 07:00 to 22:55, set chime=0 to turn off, 1 to turn on 4th quarter, 2 to turn on all quarters, 3 to turn on all quarters plus hour counting strick
hardware list: Arduino nano, AHT10 temp and humidity sensor, 4-digit display w/TM1637, buzzer, 2x micro switch
 */
 
#include <avr/pgmspace.h>

//AHT sensor
#include <Wire.h> // ‎A4 (SDA), A5 (SCL)
#include <AHT10.h>
const float humOffset=0.00; //for humidity calibration
const float tempOffset=-2.20; //for temp calibration
AHT10 myAHT10(AHT10_ADDRESS_0X38);
float humidity;
float temperature;

//real time clock
unsigned long minTime=59972; //arduino 1 minute clock calibration
int yy = 20, mmm = 7, dd = 15, dow=3, h = 12, m = 30, aH = 24, aM = 00; //reset to 2020Jul15 Wed 12:30, alarm 24:00 off
int monthDay[]={0,31,59,90,120,151,181,212,243,273,304,334}; 
int cAlarm = 0; //clock alarm status
int tmr = 0; //timer in minute
int tmrAlarm = 0; //timer alarm status
const int modeSW = A0; //set mode switch pin, behide the min digit
const int incSW = A1; //set increment switch pin , behide the hr digit
int modeST = 0; //mode switch status
int incST = 0; //increment switch status
int setMode = 0; //0,1,2,3,4,5,6,7,8,9,10 run, set timer, alarm hr, alarm min, year, month, day, hr, min, chime, brightness
unsigned long timeStart = 0; //time start time

//TM1637
#include <TM1637Display.h>
#define CLK 10 //LED clk
#define DIO 11 //LED data
TM1637Display display = TM1637Display(CLK, DIO); // Create display object of type TM1637Display:
int bright = 0; //0-7 brightness
int aPos = 0; //alphabet position pointer
int cycle =0; //0,1,2,3=display time with/without colon, 4=timer, 5=temperature, 6=humidity
int cycleTime=500; //normal display cycle time
unsigned long cycleStart = 0; //display cycle start
String dName = "aaa";
uint8_t sDis[] = {0,0x77,1,1,1,1,0,0x6e,0x5b,0x3f,1,1,0x40,1,1,1,0x40,1,1,0,1,1,1,0};
const uint8_t symbol[] = {0,0,0x40,0x58,0x52,0x80}; // _,_,-,c,%,:
const uint8_t digit[] = {0x3f,0x06,0x5b,0x4f,0x66,0x6d,0x7d,0x07,0x7f,0x6f}; //0123456789
const uint8_t alphabet[] = {0x77,0x7c,0x39,0x5e,0x79,0x71,0x3d,0x74,0x04, //AbCdEFGhi
                            0x0e,0x75,0x38,0x55,0x37,0x5c,0x73,0x67,0x50, //JKLMnoPqr
                            0x65,0x78,0x3e,0x3c,0x6a,0x76,0x6e,0x53}; //StUVWXyZ
const String yearMonth[] = {"JAN","FEB","MAR","APR","MAY","JUN","JUL","AUG","SEP","OCT","NOV","DEC"}; //month of year
const String weekDay[] = {"SUN","MON","TUE","WED","THR","FRI","SAT"}; //day of week

//Tone
const int BZ = 9; //Buzzer enable
int toneCount =0, lastTone=0, tickCount=0;
int toneDelay=13000; //note timing
int chimeST = 1; //07-22 chime: 0=off, 1=hh:00, 2=hh:00/15/30/45, 3=hh:00/15/30/45+hour strike
unsigned long toneStart = 0; //tone timing cycle start
byte adSam;
int s16Sam,index,stepSize,tstepSize,delta,mask;
const int indexTbl[16]={ -1,-1,-1,-1,2,4,6,8, -1,-1,-1,-1,2,4,6,8};
const int stepSizeTbl[89]={ 7,8,9,10,11,12,13,14,16,17,19,21,23,25,28,31,
    34,37,41,45,50,55,60,66,73,80,88,97,107,118,130,143,
    157,173,190,209,230,253,279,307,337,371,408,449,494,544,598,658,
    724,796,876,963,1060,1166,1282,1411,1552,1707,1878,2066,2272,2499,2749,3024,
    3327,2660,4026,4428,4871,5358,5894,6484,7132,7845,8630,9493,10442,11487,12635,13899,15289,
    16818,18500,20350,22385,24623,27086,29794,32767
  };
const uint16_t ptr[] ={0,1600,3200,4800,6400,8000};
const int notePtr[]={0,5,15,30,50};
const int note[]={3,2,1,0,99, //:13 E_Major 0=B3(re),1=E4(so),2=F#4(la),3=G#4(ti),99=rest
  1,3,2,0,99,1,2,3,1,99, //:30
  3,1,2,0,99,0,2,3,1,99,3,2,1,0,99, //:45
  1,3,2,0,99,1,2,3,1,99,3,1,2,0,99,0,2,3,1,99}; //:00
int sound[]= {1,3,2,0,99,1,2,3,1,99,3,1,2,0,99,0,2,3,1,99}; 
const uint8_t adpcm[] PROGMEM = {
//B3
0xF7,0xF7,0xF4,0x7F,0xA6,0xAD,0x06,0x90,0x4B,0xD0,0x12,0x18,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0x5A
,
//E4
0xFF,0x7F,0xF7,0x6D,0x00,0xFB,0x87,0x2A,0x3A,0x3B,0x0B,0xA7,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0xA2
,
//F#4
0x47,0x7F,0x77,0xBF,0x7F,0x31,0xF9,0x8A,0x97,0x01,0xE0,0x18,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0x3A
,
//G#4
0x7F,0x77,0x7F,0xF6,0xA4,0x38,0x4F,0xE8,0x94,0x80,0x7B,0xA9,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0x81
,
//E3
0x77,0xFF,0xFF,0x77,0xF9,0x89,0x26,0xA8,0xBA,0x71,0x82,0x8E,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0xA0
}; 

void setup() {
  display.setBrightness(bright); //Set the display brightness (0-7)
  display.clear(); // Clear the display:
  delay(100);
  Wire.begin(); //Arduino as I2C master
  delay(100);
   while (myAHT10.begin() != true) {
    display.setSegments(alphabet+4, 1, 1); //AHT 10 initialize error
    display.setSegments(alphabet+17, 1, 2);
    display.setSegments(alphabet+17, 1, 3);
    delay(200);
  }
  Wire.setClock(400000); //experimental I2C speed! 400KHz, default 100KHz
  
  timeStart = millis(); //start time tick
  cycleStart = millis();
  pinMode(BZ, OUTPUT);
  digitalWrite(BZ, LOW); //turn off buzzer
  pinMode(modeSW, INPUT_PULLUP);
  pinMode(incSW, INPUT_PULLUP);
  DDRD = B11111110; //DAC bit 1-7
  PORTD &= B00000001;
  PORTD =0;
}

void pcmPlay(uint16_t pStart, uint16_t pEnd) {
  digitalWrite(BZ, HIGH); //turn on buzzer
  s16Sam=0,index=0,stepSize=7;
  for (uint16_t k=pStart*2;k<pEnd*2;k++){
    
//get adSam nibble
    adSam=pgm_read_word_near(adpcm+int(k/2));
    if(k%2==0)adSam&=0x0F; //get adpcm from low nibble
    else adSam>>=4; //get adpcm from high nibble
    
//calculate current s16Sam from previous s16Sam+delta=(adSam+1/2)*stepSize/4
    delta=0;  
    if (adSam & 4)delta+=stepSize;
    if (adSam & 2)delta+=stepSize >>1;
    if (adSam & 1)delta+=stepSize >>2; 
    delta += stepSize >>3;
    if (adSam & 8)delta=-delta;
    s16Sam=constrain(s16Sam+delta,-32768,32767);

//get new stepsize
    index=constrain(index+indexTbl[adSam],0,88);
    stepSize=stepSizeTbl[index];
    
 //output unsigned 8 bit PCM 
    PORTD =0x80^highByte(s16Sam); //convert from signed 16bitPCM to unsigned 8bitPCM
    delayMicroseconds(114);//114us+decoder11us=125us for 8KHZ sample rate
  }
  PORTD=0;
  digitalWrite(BZ, LOW); //turn off buzzer
}
  
void loop() {
//quarter chime
  if ((toneCount>0)&&((millis()-toneStart) > toneDelay)) {
    toneStart=millis(),toneDelay=667;
    if (sound[lastTone-toneCount]<99) pcmPlay(ptr[sound[lastTone-toneCount]],ptr[sound[lastTone-toneCount]+1]);
    toneCount--;
    if (toneCount==0) toneDelay=12000;
  }
  
//hour counting chime  
  if ((toneCount==0)&&(tickCount>0)&&((millis()-toneStart) > toneDelay)) {
    toneStart=millis(), toneDelay=4000;
    pcmPlay(ptr[4],ptr[5]); //E3
    tickCount--;
  }

//one minute pass
  if(((millis() - timeStart)>=minTime)||((timeStart > millis()) && (millis() >=minTime))) { //one minute, also handle millis overflow
    timeStart = timeStart+minTime;
    cycle=0;
    tmrAlarm=0; //turn off timer alarm
    cAlarm=0; //turn off clock alarm
    if (setMode==0) {
      if (tmr == 1) tmrAlarm = 1;
      if (tmr > 0) tmr--;
    }
    m++;
    if (m == 60){
      m = 0, h++;
      tickCount=0;
      if((h>6)&&(h<23)&&(chimeST==3)) {
        tickCount=h%12;
        if(tickCount==0) tickCount=12;
      }
    }
    if ((h>6)&&(h<23)&&(((m%15==0)&&(chimeST>1))||((m==0)&&(chimeST>0)))) {
      lastTone=(int((m+45)/15)%4)*5+5;
      for (int i=0;i<lastTone;i++) sound[i]=note[notePtr[int((m+45)/15)%4]+i]; //chime
      toneCount=lastTone,toneDelay=667,toneStart=millis();
    }
    if (h == 24) {
      h = 0, dd++, dow++;
      if (dow==7) dow=0;
      switch(mmm) {
        case 4:
        case 6:
        case 9:
        case 11:
          if (dd==31) dd=1, mmm++;
          break;
        case 2:
          if ((yy%4)==0) {
            if (dd==30) dd=1, mmm++;
          }
          else if (dd==29) dd=1, mmm++;
          break;
        default:
          if (dd==32) dd=1, mmm++;
          break;
      }
      if (mmm==13) mmm=1, yy++;
    }
    if ((h == aH) && (m == aM)) cAlarm=1;
  }

//normal display cycle  
  if((millis() - cycleStart)>=cycleTime && setMode==0) {
    cycleStart = millis();
    if(tmrAlarm==1 && cycle<4) pcmPlay(ptr[cycle],ptr[cycle+1]); //B3-E4-F#4-G#4
    if(cAlarm==1 && cycle<4) cycle%2==0 ? pcmPlay(ptr[0],ptr[1]): pcmPlay(ptr[3],ptr[4]); //B3-G#4
    switch(cycle) {
      case 0:
      case 2:
        cycleTime=500;
        display.showNumberDecEx(h*100+m, 0b01000000, true, 4, 0);
        break;
      case 1:
      case 3:
        cycleTime=500;
        display.showNumberDecEx(h*100+m, 0b00000000, true, 4, 0);
        if ((tmr == 0)&&(cycle==3)) cycle++; //if no timer, skip comming show timer cycle
        break;
      case 4:
        cycleTime=2000;
        display.setSegments(alphabet+19, 1, 0); //show remain time
        display.showNumberDec(tmr, true, 3, 1);
        break;
      case 5:
        cycleTime=2000;
        temperature = myAHT10.readTemperature(AHT10_FORCE_READ_DATA)+tempOffset;
        display.showNumberDecEx(temperature*10, 0b01000000, false, 3, 0);
        display.setSegments(symbol+3, 1, 3);
        break;
      case 6:
        cycleTime=2000;
        humidity = myAHT10.readHumidity(AHT10_USE_READ_DATA)+humOffset;
        display.showNumberDecEx(humidity*10, 0b01000000, false, 3, 0);
        display.setSegments(symbol+4, 1, 3);
        break;
    }
    cycle++;
    if (cycle==7) cycle=0;
  }

//press both inc and mode switch
  modeST = digitalRead(modeSW);
  incST = digitalRead(incSW);
  if (modeST == LOW || incST == LOW) {
    if (tmrAlarm == 1 || cAlarm ==1) {
      tmrAlarm = 0; //if alarm on, press any switch to turn alarm off
      cAlarm = 0;
    }
    else if (modeST == LOW && incST == LOW) { 
      switch(setMode) {
        case 0:
          break;
        case 1:
          tmr=0;
          break;
        case 2:
          aH = 0;
          break;
        case 3:
          aM = 0;
          break;
        case 4:
          yy = 20;
          break;
        case 5:
          mmm = 1;
          break;
        case 6:
          dd = 1;
          break;
        case 7:
          h = 0;
          break;
        case 8:
          m = 0;
          break;
        case 9:
          chimeST = 0;
          break;
        case 10:
          bright = 0;
          display.setBrightness(bright);
          break;
      }
    }

  //press increment switch
    else if (modeST == LOW) { //change mode
      setMode++;
      if (setMode == 11) setMode = 0; 
    }
    else { //increment
      switch(setMode) {
        case 0:
          sDis[2] = digit[int(aH/10)]; //hhmm
          sDis[3] = digit[aH%10];
          sDis[4] = digit[int(aM/10)];
          sDis[5] = digit[aM%10];
          sDis[10] = digit[int(yy/10)];
          sDis[11] = digit[yy%10];
          dName = yearMonth[mmm-1];
          for (int i=0;i<3;i++) {
            sDis[i+13]=alphabet[dName[i]-65]; //mmm
          }
          sDis[17] = digit[int(dd/10)];
          sDis[18] = digit[dd%10];
          dName = weekDay[dow];
          for (int i=0;i<3;i++) {
            sDis[i+20]=alphabet[dName[i]-65]; //ddd
          }
          for (int i=0;i<21;i++) {
            display.setSegments(sDis+i, 4, 0); 
            delay(500);     
          }
          break;
        case 1: //set timer mode
          tmr++;
          if (tmr == 961) tmr = 0; //maximum 16 hour timer
          break;
        case 2: //set alarm hr mode
          aH++;
          if (aH == 25) aH = 0;
          break;
        case 3: //set alarm min mode
          aM++;
          if (aM == 60) aM = 0;
          break;
        case 4: //set year mode
          yy++;
          if (yy == 100) yy = 0;
          break;
        case 5: //set month mode
          mmm++;
          if (mmm == 13) mmm = 1;
          switch(mmm) {
            case 4:
            case 6:
            case 9:
            case 11:
              if (dd == 31) dd = 30;
              break;
            case 2:
              if ((yy%4) == 0) {
                if (dd >= 30) dd = 29;
              }
              else if (dd >= 29) dd = 28;
              break;
          }
          break;
        case 6: //set day mode
          dd++;
          switch(mmm) {
            case 1:
            case 3:
            case 5:
            case 7:
            case 8:
            case 10:
            case 12:
              if (dd == 32) dd = 1;
              break;
            case 4:
            case 6:
            case 9:
            case 11:
              if (dd >= 31) dd = 1;
              break;
            case 2:
              if ((yy%4) == 0) {
                if (dd >= 30) dd = 1;
              }
              else if (dd >= 29) dd = 1;
              break;
          }
          break;
        case 7: //set hr mode
          h++;
          if (h == 24) h = 0;
          break;
        case 8: //set min mode
          m++;
          if (m == 60) m = 0;
          timeStart = millis();
          cycleStart = millis();
          break;
        case 9: //set chime mode
          chimeST++;
          if (chimeST == 4) chimeST = 0;
          break;
        case 10: //set brightness
          bright++;
          if (bright == 8) bright = 0;
          display.setBrightness(bright);
          break;
      }
      dow=((yy)*365L+int((yy+3)/4)+monthDay[mmm-1]+(mmm>2 && yy%4==0)+dd-1+6)%7; //2000 Jan 01 was Saturday
    }

//press mode switch
    switch(setMode) {
      case 0:
        break;
      case 1: //set timer mode
        display.setSegments(alphabet+19, 1, 0); //t
        display.showNumberDec(tmr, true, 3, 1);
        break;
      case 2: //set alarm hr mode
        display.showNumberDec(aH, true, 2, 0);
        display.setSegments(symbol, 2, 2); // hh--
        break;
      case 3: //set alarm min mode
        display.setSegments(symbol, 2, 0); //--mm
        display.showNumberDec(aM, true, 2, 2);
        break;
      case 4: //set year mode
        display.setSegments(alphabet+24, 1, 0); //y
        display.showNumberDec(yy, true, 2, 2);
        break;
      case 5: //set month mode
        display.setSegments(alphabet+12, 1, 0); //M
        display.showNumberDec(mmm, true, 2, 2);
        break;
      case 6: //set day mode
        display.setSegments(alphabet+3, 1, 0); //d
        display.showNumberDec(dd, true, 2, 2);
        break;
      case 7: //set hr mode
        display.showNumberDecEx(h, 0b01000000, true, 2, 0);
        display.setSegments(symbol, 2, 2); //hh:--
        break;
      case 8: //set min mode
        display.setSegments(symbol, 1, 0); //--:mm
        display.setSegments(symbol+5, 1, 1);
        display.showNumberDec(m, true, 2, 2);
        break;
      case 9: //set chime mode
        display.setSegments(alphabet+2, 1, 0); //C
        display.showNumberDec(chimeST, false, 3, 1);
        break;
      case 10: //set brightness
        display.setSegments(alphabet+1, 1, 0); //B
        display.showNumberDec(bright, false, 3, 1);
        break;
    }
    cycle=0;
    delay(500);
  }
}
